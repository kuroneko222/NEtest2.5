## config/boards/shields/Kconfig.shield
```kconfig
config SHELD_NEtest3_R
    def_bool $(shields_list_contains,NEtest3_R)

config SHIELD_NEtest3_L
    def_bool $(shields_list_contains,NEtest3_L)
```

## config/boards/shields/Test/Kconfig.defconfig
```kconfig
if SHIELD_NEtest3_R

config ZMK_KEYBOARD_NAME
    default "NEtest3_R"

config ZMK_SPLIT
    default y

config ZMK_SPLIT_ROLE_CENTRAL
    default y

endif

if SHIELD_NEtest3_L

config ZMK_KEYBOARD_NAME
    default "NEtest3_L"

config ZMK_SPLIT
    default y

endif
```

## config/west.yml
```yaml
manifest:
  remotes:
    - name: zmkfirmware
      url-base: https://github.com/zmkfirmware
    - name: kuroneko222
      url-base: https://github.com/kuroneko222
  projects:
    - name: zmk
      remote: zmkfirmware
      revision: main
      import: app/west.yml
    - name: ergonautkb-zmk-module
      remote: ergonautkb
      revision: main
  self:
    path: config
```
